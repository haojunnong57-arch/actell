## firmware/main/Kconfig.projbuild
```kconfig
menu "Experimental iPhone USB transport"
config BRIDGE_USB_WIRING_CONFIRMED
    bool "Board/USB-C role/VBUS wiring has been independently verified"
    default n
    help
        This project cannot verify your board or supply 5 V through software.
        No GPIO power switch is assumed or controlled. Verify safe VBUS,
        correct Host data role, physical USB path, and no power backfeeding.
config BRIDGE_USB_HOST_ENABLE
    bool "Run one bounded USB mux and read-only lockdown QueryType probe"
    depends on BRIDGE_USB_WIRING_CONFIRMED
    default n
    help
        Experimental and NOT hardware-validated. Enables the internal USB
        OTG Host controller, enumerates an Apple device and sends QueryType.
        Does not pair, access private data, or enable screenshot/touch.
        Default is off. Do not enable based only on the N16R8 purchase name.
config BRIDGE_USB_CONFIGURATION_VALUE
    int "Observed iPhone bConfigurationValue containing FF/FE/02 bulk interface"
    range 1 255
    default 1
    help
        Set the value from actual USB descriptors. 1 is only an initial
        configuration value; this firmware rejects missing/ambiguous mux
        interfaces and does not guess or automatically change USB modes.
config BRIDGE_USB_PROBE_RUNTIME_MS
    int "Maximum active USB probe time in milliseconds"
    range 1000 600000
    default 30000
    help
        Operational deadline. Each subsequent cleanup wait has its own
        bounded 2-second allowance; arbitrary callbacks cannot be preempted.
endmenu
```
